/*
 * ZMK 公式の studio-rpc-usb-uart snippet と同じ内容。
 * USB の仮想シリアルポートで ZMK Studio / DYA Studio とつなぐ。
 */

/ {
    chosen {
        zmk,studio-rpc-uart = &snippet_studio_rpc_usb_uart;
    };
};

&zephyr_udc0 {
    snippet_studio_rpc_usb_uart: snippet_studio_rpc_usb_uart {
        compatible = "zephyr,cdc-acm-uart";
    };
};
