## boards/shields/timothy_v2/Kconfig.shield
```kconfig
config SHIELD_TIMOTHY_V2_LEFT
    def_bool $(shields_list_contains,timothy_v2_left)

config SHIELD_TIMOTHY_V2_RIGHT
    def_bool $(shields_list_contains,timothy_v2_right)
```
