## boards/shields/timothy_v2/Kconfig.defconfig
```kconfig
# ---------------------------------------------------------------------------
# PC とつながる側 (セントラル)
#   ドングルなし版: 左手側
#   ドングル版    : ドングル (左手側は build.yaml の cmake-args でペリフェラルにする)
# ---------------------------------------------------------------------------

if SHIELD_TIMOTHY_V2_LEFT || SHIELD_TIMOTHY_V2_DONGLE

config ZMK_KEYBOARD_NAME
    default "Timothy_v2"

config ZMK_SPLIT_ROLE_CENTRAL
    default y

# ペリフェラルの電池残量を取得し、PC にも通知する。
# ドングル版の左手側は cmake-args でペリフェラルにするので、セントラルのときだけ有効にする。
config ZMK_SPLIT_BLE_CENTRAL_BATTERY_LEVEL_FETCHING
    default y if ZMK_SPLIT_ROLE_CENTRAL

config ZMK_SPLIT_BLE_CENTRAL_BATTERY_LEVEL_PROXY
    default y if ZMK_SPLIT_ROLE_CENTRAL

endif # SHIELD_TIMOTHY_V2_LEFT || SHIELD_TIMOTHY_V2_DONGLE

if SHIELD_TIMOTHY_V2_LEFT || SHIELD_TIMOTHY_V2_RIGHT || SHIELD_TIMOTHY_V2_DONGLE

config ZMK_SPLIT
    default y

endif

# ---------------------------------------------------------------------------
# ドングル: 左右の 2 台をペリフェラルとして受ける
# ---------------------------------------------------------------------------

if SHIELD_TIMOTHY_V2_DONGLE

config ZMK_SPLIT_BLE_CENTRAL_PERIPHERALS
    default 2

# ペリフェラル 2 台 + PC 用の接続先 5 つ
config BT_MAX_CONN
    default 7

config BT_MAX_PAIRED
    default 7

endif # SHIELD_TIMOTHY_V2_DONGLE
```

## config/west.yml
```yaml
# DYA Studio (https://dyastudio-te9no.netlify.app/developer-guide) のレベル 2 に対応するため、
# ZMK 本体を Custom Studio Protocol 対応のフォーク (cormoran/zmk main+dya, Zephyr 4.1) にしている。
# 公式 ZMK に戻すときは、zmk / zephyr を zmkfirmware のものに戻し、cormoran のモジュールを外す。
manifest:
  remotes:
    - name: zmkfirmware
      url-base: https://github.com/zmkfirmware
    - name: cormoran
      url-base: https://github.com/cormoran
  projects:
    - name: zmk
      remote: cormoran
      revision: main+dya
      import:
        file: app/west.yml
    - name: zephyr
      remote: cormoran
      revision: v4.1.0+zmk-fixes+nrf-half-duplex-uart
      clone-depth: 1
      import:
        name-blocklist:
          - ci-tools
          - hal_altera
          - hal_cypress
          - hal_infineon
          - hal_microchip
          - hal_nxp
          - hal_openisa
          - hal_xtensa
          - hal_st
          - hal_ti
          - loramac-node
          - mcuboot
          - mcumgr
          - net-tools
          - openthread
          - edtt
          - trusted-firmware-m

    # ---- コア (ほかのモジュールが使う設定の仕組みと、キーマップ読み込みの高速化) ----
    - name: zmk-feature-custom-settings
      remote: cormoran
      revision: main
    - name: zmk-feature-fast-keymap
      remote: cormoran
      revision: main

    # ---- Keymap / Macro / Combo タブ ----
    - name: zmk-feature-runtime-macro
      remote: cormoran
      revision: main
    - name: zmk-feature-runtime-combo
      remote: cormoran
      revision: main
    - name: zmk-feature-input-stream
      remote: cormoran
      revision: main

    # ---- Connection タブ ----
    - name: zmk-module-ble-management
      remote: cormoran
      revision: main
    - name: zmk-feature-default-layer
      remote: cormoran
      revision: codex/custom-rpc-rewrite
    - name: zmk-feature-os-detection
      remote: cormoran
      revision: main

    # ---- Settings タブ ----
    - name: zmk-module-settings-rpc
      remote: cormoran
      revision: main

    # ---- 診断と開発補助タブ ----
    - name: zmk-feature-device-info
      remote: cormoran
      revision: main
    - name: zmk-feature-watchdog
      remote: cormoran
      revision: main
    - name: zmk-module-devtool
      remote: cormoran
      revision: main
    - name: zmk-feature-kscan-diagnostics
      remote: cormoran
      revision: main
  self:
    path: config
```

## drivers/sensor/battery_alkaline/Kconfig
```kconfig
DT_COMPAT_TIMOTHY_BATTERY_ALKALINE := timothy,battery-alkaline

config TIMOTHY_BATTERY_ALKALINE
    bool "Alkaline cell battery monitoring (direct ADC input)"
    default $(dt_compat_enabled,$(DT_COMPAT_TIMOTHY_BATTERY_ALKALINE))
    select ADC
    select ZMK_BATTERY
    depends on SENSOR
    help
        Measure an alkaline cell connected directly to an ADC pin and
        convert the voltage to state of charge with an alkaline discharge curve.
```

## dts/bindings/sensor/timothy,battery-alkaline.yaml
```yaml
description: |
  Alkaline cell(s) measured through a resistor divider on an nRF52 SAADC input.
  State of charge is derived from an alkaline discharge curve.

  Battery+ --[R1]--+-- ADC pin --[R2]-- GND
    output-ohms = R2, full-ohms = R1 + R2

compatible: "timothy,battery-alkaline"

include: voltage-divider.yaml

properties:
  cells:
    type: int
    default: 1
    description: Number of cells in series.
```
